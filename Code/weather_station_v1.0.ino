

// ----- BLYNK CREDENTIALS (Điền thông tin từ Blynk Console) -----
#define BLYNK_TEMPLATE_ID ""
#define BLYNK_TEMPLATE_NAME ""
#define BLYNK_AUTH_TOKEN ""

// ----- WIFI CREDENTIALS (Điền thông tin WiFi của bạn) -----
#define WIFI_SSID     ""    // Tên WiFi
#define WIFI_PASSWORD ""    // Mật khẩu WiFi

// ----- BLYNK VIRTUAL PINS (Theo datastream đã cấu hình) -----
#define VPIN_TEMPERATURE  V0  // Nhiệt độ (Integer, °C, -50 to 50)
#define VPIN_HUMIDITY     V1  // Độ ẩm (Integer, %, 0 to 100)
#define VPIN_RAIN_LEVEL   V2  // Mức mưa (Integer, %, 0 to 100)
#define VPIN_RAIN_STATUS  V3  // Trạng thái mưa (String)
#define VPIN_PRESSURE     V4  // Áp suất (Integer, hPa, 900 to 1100)
#define VPIN_DIGITAL      V5  // Digital (Integer, 0 or 1)
#define VPIN_DATA_ENABLE  V6  // Bật/Tắt gửi dữ liệu (Integer, 0=OFF, 1=ON)
#define VPIN_WIND_SPEED   V7  // Tốc độ gió (Double, km/h, 0 to 200)

// ----- BLYNK SETTINGS -----
#define BLYNK_PRINT Serial    // In debug log ra Serial Monitor
#define BLYNK_UPDATE_INTERVAL 2000   // Gửi dữ liệu mỗi 2s (milliseconds)

// ----- BACKEND SERVER (MongoDB) -----
#define BACKEND_SERVER_URL ""  // Thay bằng IP máy tính chạy backend
#define DEVICE_TOKEN ""  // Token xác thực từ MongoDB

/*
 * =====================================================================
 */

#include <WiFi.h>
#include <BlynkSimpleEsp32.h>
#include <Wire.h>
#include <Adafruit_GFX.h>
#include <Adafruit_SSD1306.h>
#include <Adafruit_BMP280.h>
#include <WebServer.h>
#include <LittleFS.h>
#include <ArduinoJson.h>
#include <HTTPClient.h>  // HTTP Client cho backend
#include <Update.h>  // OTA Update

#define SPIFFS LittleFS  // Alias để code cũ vẫn chạy

// ====================== FIRMWARE VERSION ======================
#define FIRMWARE_VERSION "v1.0"

// ====================== CẤU HÌNH ======================
#define SCREEN_WIDTH   128
#define SCREEN_HEIGHT   64
#define OLED_ADDR     0x3C

#define SDA_PIN 21
#define SCL_PIN 22

#define AHT20_ADDR 0x38

// Rain sensor
#define RAIN_AO 32  // GPIO 32 (ADC1 - hoạt động với WiFi)
#define RAIN_DO 2

// Wind speed sensor (Hall sensor A3144)
#define HALL_PIN 27  // GPIO 27 - Hall sensor để đo tốc độ gió

// Bật/tắt animation: 0 = tắt , 1 = bật 
#define USE_ANIM 1

// Kích thước frame animation 
#define FRAME_WIDTH  32
#define FRAME_HEIGHT 32

// Macro đếm phần tử mảng
#define COUNT_OF(arr) (sizeof(arr)/sizeof((arr)[0]))

// ====================== THIẾT BỊ ======================
Adafruit_SSD1306 display(SCREEN_WIDTH, SCREEN_HEIGHT, &Wire, -1);
Adafruit_BMP280   bmp280;
WebServer server(80);  // Web server on port 80

// ====================== BIẾN TRẠNG THÁI ======================
int currentPage = 0;
unsigned long lastPageChange = 0;
const unsigned long PAGE_INTERVAL = 4000;

float aht20_temp = 0;
float aht20_humidity = 0;
int   rain_analog = 0;
int   rain_digital = 0;
int   rain_level_percent = 0;
float pressure = 0;
float wind_speed = 0;  // Tốc độ gió (km/h)

String rain_status = "DRY";

// ===== Wind speed variables =====
volatile unsigned long wind_pulse_count = 0;  // Đếm số lần nam châm đi qua
unsigned long last_wind_calc_time = 0;
#define WIND_CALC_INTERVAL 2000  // Tính tốc độ gió mỗi 2 giây
#define WIND_MAGNETS 1          // Số nam châm trên quạt (1 nam châm = 1 xung/vòng)
#define WIND_RADIUS 0.024       // Bán kính từ tâm đến nam châm (mét) = 2.4cm

// ===== Blynk state =====
BlynkTimer blynkTimer;
unsigned long lastBlynkUpdate = 0;
bool blynkDataEnabled = true;  // Trạng thái gửi dữ liệu (mặc định: BẬT)
bool showPage3 = false;  // Flag để hiện trang 3 khi bấm nút
unsigned long page3ShowTime = 0;  // Thời điểm bắt đầu hiện trang 3
#define PAGE3_DISPLAY_DURATION 3000  // Hiện trang 3 trong 3 giây
bool blynkFirstSync = true;  // Flag để bỏ qua lần sync đầu tiên khi boot

// ===== Animation state =====
#define FRAME_DELAY 50  // 50ms mỗi frame = 20 FPS (mượt mà, không quá nhanh)
int tempAnimFrame = 0;
int humidityAnimFrame = 0;
int dataAnimFrame = 0;
unsigned long lastFrameUpdate = 0;

// ===== Sensor reading timing (non-blocking) =====
#define SENSOR_READ_INTERVAL 1000  // Đọc AHT20 mỗi 1 giây
unsigned long lastSensorRead = 0;
bool sensorReadInProgress = false;
unsigned long sensorTriggerTime = 0;

#define RAIN_READ_INTERVAL 200  // Đọc rain sensor mỗi 0.2 giây (nhanh để phát hiện mưa kịp thời)
unsigned long lastRainRead = 0;

// ====================== KHAI BÁO TRƯỚC (FORWARD DECLARATIONS) ======================
bool aht20_begin();
void aht20_read();
void detectRain(int analog, int digital, float humidity, float pressure);
void updateAnimationFrames();
const uint8_t* getTempFrame();
void displayPage1();
void displayPage2();
void displayPage3();
void setupSPIFFS();
void setupWebServer();
String getWeatherJSON();

// ====================== ANIMATION FRAMES ======================


#if USE_ANIM
//  COLD (Lạnh) - Snowflake animation 

const uint8_t PROGMEM coldFrames[][ (FRAME_WIDTH * FRAME_HEIGHT) / 8 ] = {
{0,0,3,0,0,0,3,0,0,0,7,0,0,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0,0},
  {0,0,1,0,0,0,3,0,0,0,3,128,0,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0,0},
  {0,0,1,0,0,0,3,0,0,0,11,128,0,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0,0},
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  {0,0,2,0,0,0,3,0,0,0,7,64,0,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0,0}
};

// NORMAL (Bình thường)
const uint8_t PROGMEM normalFrames[][ (FRAME_WIDTH * FRAME_HEIGHT) / 8 ] = {
 {0,0,0,0,0,0,0,0,0,0,0,0,0,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0,0},
  {0,0,0,0,0,0,0,0,0,0,0,0,0,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0,0},
  {0,0,0,0,0,0,0,0,0,0,0,0,0,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0,0},
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  {0,0,0,0,0,0,0,0,0,0,0,0,0,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0,0}
};

//  HOT (Nóng)
const uint8_t PROGMEM hotFrames[][ (FRAME_WIDTH * FRAME_HEIGHT) / 8 ] = {
  {0,2,0,0,0,7,0,0,0,5,128,0,0,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2,0},
  {0,0,0,0,0,6,0,0,0,7,0,0,0,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2,0},
  {0,0,0,0,0,0,0,0,0,24,0,0,0,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4,0},
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  {0,0,0,0,0,3,0,0,0,3,192,0,0,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2,0}
};

// =====  HUMIDITY (Độ ẩm) =====

const uint8_t PROGMEM humidityFrames[][ (FRAME_WIDTH * FRAME_HEIGHT) / 8 ] = {
{0,3,192,0,0,6,96,0,0,12,48,0,0,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192,0},
  {0,3,192,0,0,6,96,0,0,12,48,0,0,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192,0},
  {0,3,192,0,0,6,96,0,0,12,48,0,0,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192,0},
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  {0,3,192,0,0,6,96,0,0,12,48,0,0,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192,0}
};

//==== Icon bật tắt data ====
const uint8_t PROGMEM dataFrames[][ (FRAME_WIDTH * FRAME_HEIGHT) / 8 ] = {
  {0,0,0,0,0,0,0,0,0,0,0,0,0,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0,0},
  {0,0,0,0,0,0,0,0,0,0,0,0,0,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0,0},
  {0,0,0,0,0,0,0,0,0,0,0,0,0,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0,0},
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  {0,0,0,0,0,0,0,0,0,0,0,0,0,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0,0}
};


// ====================== Startup icon ======================
const uint8_t PROGMEM startupFrames[][ (FRAME_WIDTH * FRAME_HEIGHT) / 8 ] = {
  {0,0,0,0,0,1,128,0,0,17,136,0,0,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0,0},
  {0,0,0,0,0,1,128,0,0,17,136,0,0,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0,0},
  {0,0,0,0,0,1,128,0,0,17,136,0,0,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0,0},
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  {0,0,0,0,0,1,128,0,0,17,136,0,0,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0,0}
};

#else
// Khi tắt animation, để mảng giả (dummy) có 1 khung 1x1 byte để code vẫn link được
// Đồng thời trong code, nếu USE_ANIM=0 sẽ không gọi drawBitmap các frame này.
const uint8_t PROGMEM coldFrames[][1]    = { {0x00} };
const uint8_t PROGMEM normalFrames[][1]  = { {0x00} };
const uint8_t PROGMEM hotFrames[][1]     = { {0x00} };
const uint8_t PROGMEM humidityFrames[][1]= { {0x00} };
#endif

// ====================== BLYNK FUNCTIONS ======================

// ----- Kết nối WiFi -----
void connectToWiFi() {
  Serial.println("\n=== Connecting to WiFi ===");
  Serial.print("SSID: ");
  Serial.println(WIFI_SSID);

  display.println("Connecting WiFi...");
  display.display();

  WiFi.begin(WIFI_SSID, WIFI_PASSWORD);

  int attempts = 0;
  while (WiFi.status() != WL_CONNECTED && attempts < 20) {
    delay(500);
    Serial.print(".");
    display.print(".");
    display.display();
    attempts++;
  }

  if (WiFi.status() == WL_CONNECTED) {
    Serial.println("\n✓ WiFi connected!");
    Serial.print("IP Address: ");
    Serial.println(WiFi.localIP());
    Serial.print("Signal Strength (RSSI): ");
    Serial.print(WiFi.RSSI());
    Serial.println(" dBm");

    display.println(" OK");
    display.display();
    delay(500);
  } else {
    Serial.println("\n✗ WiFi connection failed!");
    Serial.println("Check your SSID and password at the top of this file");

    display.println(" FAIL");
    display.display();
    delay(1000);
  }
}

// ----- Kết nối Blynk -----
void connectToBlynk() {
  Serial.println("\n=== Connecting to Blynk ===");
  Serial.print("Template ID: ");
  Serial.println(BLYNK_TEMPLATE_ID);

  display.println("Connecting Blynk...");
  display.display();

  Blynk.config(BLYNK_AUTH_TOKEN);

  int attempts = 0;
  while (!Blynk.connect() && attempts < 10) {
    Serial.print(".");
    display.print(".");
    display.display();
    delay(1000);
    attempts++;
  }

  if (Blynk.connected()) {
    Serial.println("\n✓ Blynk connected!");
    Serial.println("Dashboard ready to receive data");

    display.println(" OK");
    display.display();
    delay(500);
  } else {
    Serial.println("\n✗ Blynk connection failed!");
    Serial.println("Check your AUTH_TOKEN at the top of this file");

    display.println(" FAIL");
    display.display();
    delay(1000);
  }
}

// ----- Khởi tạo Blynk -----
void initBlynk() {
  connectToWiFi();
  if (WiFi.status() == WL_CONNECTED) {
    connectToBlynk();
  } else {
    Serial.println("✗ Cannot connect to Blynk without WiFi");
  }
}

// ----- Gửi dữ liệu lên Blynk -----
void sendDataToBlynk(float temperature, float humidity, int rainLevel,
                     String rainStatus, float pressure, int digitalVal) {
  if (!Blynk.connected()) {
    Serial.println("⚠ Blynk disconnected. Attempting to reconnect...");
    connectToBlynk();
    return;
  }

  Blynk.virtualWrite(VPIN_TEMPERATURE, (int)temperature);
  Blynk.virtualWrite(VPIN_HUMIDITY, (int)humidity);
  Blynk.virtualWrite(VPIN_RAIN_LEVEL, rainLevel);
  Blynk.virtualWrite(VPIN_RAIN_STATUS, rainStatus);
  Blynk.virtualWrite(VPIN_PRESSURE, (int)pressure);
  Blynk.virtualWrite(VPIN_DIGITAL, digitalVal);
  Blynk.virtualWrite(VPIN_WIND_SPEED, wind_speed);

  Serial.println("\n📤 Data sent to Blynk:");
  Serial.printf("  V0 (Temp): %d°C\n", (int)temperature);
  Serial.printf("  V1 (Humidity): %d%%\n", (int)humidity);
  Serial.printf("  V2 (Rain Level): %d%%\n", rainLevel);
  Serial.printf("  V3 (Rain Status): %s\n", rainStatus.c_str());
  Serial.printf("  V4 (Pressure): %d hPa\n", (int)pressure);
  Serial.printf("  V5 (Digital): %d\n", digitalVal);
  Serial.printf("  V7 (Wind Speed): %.1f km/h\n", wind_speed);
}

// ----- Xử lý Blynk trong loop -----
void handleBlynk(float temperature, float humidity, int rainLevel,
                 String rainStatus, float pressure, int digitalVal) {
  Blynk.run();

  unsigned long currentMillis = millis();
  if (currentMillis - lastBlynkUpdate >= BLYNK_UPDATE_INTERVAL) {
    lastBlynkUpdate = currentMillis;

    // Chỉ gửi dữ liệu nếu được bật
    if (blynkDataEnabled) {
      sendDataToBlynk(temperature, humidity, rainLevel, rainStatus, pressure, digitalVal);
    }
  }
}

// ----- Blynk Events -----
BLYNK_CONNECTED() {
  Serial.println("🟢 Blynk Connected Event");

  // Sync trạng thái V6 từ server (giữ trạng thái khi reconnect)
  // Không gửi lên để tránh trigger BLYNK_WRITE và hiện page 3 không mong muốn
  Blynk.syncVirtual(VPIN_DATA_ENABLE);
}

BLYNK_DISCONNECTED() {
  Serial.println("🔴 Blynk Disconnected Event");
}

// ----- Callback khi bật/tắt switch V6 -----
BLYNK_WRITE(VPIN_DATA_ENABLE) {
  int value = param.asInt();  // Nhận giá trị 0 hoặc 1
  blynkDataEnabled = (value == 1);

  if (blynkDataEnabled) {
    Serial.println("✅ Data sending ENABLED");
  } else {
    Serial.println("⛔ Data sending DISABLED");
  }

  // Chỉ hiển thị trang 3 nếu KHÔNG phải lần sync đầu tiên khi boot
  if (!blynkFirstSync) {
    showPage3 = true;
    page3ShowTime = millis();
  } else {
    // Lần đầu tiên sync từ server, chỉ cập nhật trạng thái, không hiện page 3
    blynkFirstSync = false;
    Serial.println("📥 Initial sync complete, page 3 not shown in loop");
  }
}

// ====================== MONGODB BACKEND FUNCTIONS ======================

unsigned long lastBackendSend = 0;
#define BACKEND_SEND_INTERVAL 5000  // Gửi dữ liệu mỗi 5 giây

void sendDataToBackend(float temperature, float humidity, float pressure,
                        int rain_level, float wind_speed, String rain_status) {
  unsigned long now = millis();

  // Chỉ gửi mỗi 5 giây để tránh spam
  if (now - lastBackendSend < BACKEND_SEND_INTERVAL) {
    return;
  }

  lastBackendSend = now;

  HTTPClient http;
  String url = String(BACKEND_SERVER_URL) + "/api/weather";

  http.begin(url);
  http.addHeader("Content-Type", "application/json");
  http.addHeader("Authorization", "Bearer " + String(DEVICE_TOKEN));

  // Tạo JSON payload
  StaticJsonDocument<256> doc;
  doc["temperature"] = temperature;
  doc["humidity"] = humidity;
  doc["pressure"] = pressure;
  doc["rain_level"] = rain_level;
  doc["wind_speed"] = wind_speed;
  doc["rain_status"] = rain_status;

  String payload;
  serializeJson(doc, payload);

  Serial.println("\n📡 Sending data to MongoDB backend...");
  Serial.println("URL: " + url);
  Serial.println("Payload: " + payload);

  int httpCode = http.POST(payload);

  if (httpCode == 200 || httpCode == 201) {
    Serial.println("✅ Data saved to MongoDB successfully!");
    String response = http.getString();
    Serial.println("Response: " + response);
  } else {
    Serial.print("❌ Error sending to MongoDB: HTTP ");
    Serial.println(httpCode);
    if (httpCode > 0) {
      Serial.println("Response: " + http.getString());
    }
  }

  http.end();
}

// ====================== WIND SPEED FUNCTIONS ======================
// Interrupt handler cho Hall sensor (gọi khi phát hiện nam châm)
void IRAM_ATTR wind_pulse_isr() {
  wind_pulse_count++;
}

// Hàm tính tốc độ gió từ số xung Hall sensor
void calculateWindSpeed() {
  unsigned long current_time = millis();
  unsigned long elapsed_time = current_time - last_wind_calc_time;

  if (elapsed_time >= WIND_CALC_INTERVAL) {
    // Lấy số xung và reset ngay để tránh mất xung
    noInterrupts();
    unsigned long pulses = wind_pulse_count;
    wind_pulse_count = 0;
    interrupts();

    // Tính thời gian (giây)
    float time_seconds = elapsed_time / 1000.0;

    // Tính số vòng quay (1 nam châm = 1 xung/vòng)
    float rotations = (float)pulses / WIND_MAGNETS;

    // Tính số vòng quay/giây (RPS)
    float rps = rotations / time_seconds;

    // Chu vi quỹ đạo nam châm (mét)
    float circumference = 2.0 * PI * WIND_RADIUS;  // = 0.1508m

    // Tốc độ (m/s) = RPS × Chu vi
    float speed_ms = rps * circumference;

    // Chuyển sang km/h
    wind_speed = speed_ms * 3.6;

    last_wind_calc_time = current_time;
  }
}

// ====================== SETUP ======================
void setup() {
  Serial.begin(115200);
  delay(300);

  Serial.println("\n\n=== ESP32 + OLED + Weather Display ===");

  Wire.begin(SDA_PIN, SCL_PIN);
  delay(200);

  pinMode(RAIN_DO, INPUT);
  analogSetWidth(12);

  // Hall sensor setup
  pinMode(HALL_PIN, INPUT_PULLUP);
  attachInterrupt(digitalPinToInterrupt(HALL_PIN), wind_pulse_isr, FALLING);
  last_wind_calc_time = millis();
  Serial.println("✓ Hall sensor initialized on GPIO 27");

  // OLED
  Serial.println("Initializing OLED...");
  if (!display.begin(SSD1306_SWITCHCAPVCC, OLED_ADDR)) {
    Serial.println("✗ OLED not found!");
    while (1) { delay(10); }
  }
  Serial.println("✓ OLED found");
  display.clearDisplay();
  display.setTextSize(1);
  display.setTextColor(SSD1306_WHITE);
  display.setCursor(0, 0);
  display.println("Init OLED... OK");
  display.display();
  delay(500);

  // AHT20
  Serial.println("Initializing AHT20...");
  display.println("Init AHT20...");
  display.display();
  if (!aht20_begin()) {
    Serial.println("✗ AHT20 not found!");
    display.println("AHT20 ERROR!");
    display.display();
    while (1) { delay(10); }
  }
  Serial.println("✓ AHT20 found");
  display.println("AHT20... OK");
  display.display();
  delay(500);

  // BMP280
  Serial.println("Initializing BMP280...");
  display.println("Init BMP280...");
  display.display();
  if (!bmp280.begin(0x77)) {
    Serial.println("✗ BMP280 not found!");
    display.println("BMP280 FAIL!");
    display.display();
  } else {
    Serial.println("✓ BMP280 found");
    display.println("BMP280... OK");
    display.display();
    bmp280.setSampling(
      Adafruit_BMP280::MODE_NORMAL,
      Adafruit_BMP280::SAMPLING_X2,   // Temp oversampling
      Adafruit_BMP280::SAMPLING_X16,  // Pressure oversampling
      Adafruit_BMP280::FILTER_X16,
      Adafruit_BMP280::STANDBY_MS_500
    );
  }
  delay(500);

  // ===== KHỞI TẠO BLYNK =====
  // Kết nối WiFi và Blynk
  initBlynk();

  // Đợi và chạy Blynk.run() để xử lý callbacks (sync từ server)
  Serial.println("⏳ Waiting for Blynk to sync...");
  for (int i = 0; i < 20; i++) {
    Blynk.run();
    delay(100);  // Tổng 2 giây, nhưng cho phép Blynk xử lý callbacks
  }
  Serial.print("📊 After sync, blynkDataEnabled = ");
  Serial.println(blynkDataEnabled ? "ENABLED" : "DISABLED");

  // ===== KHỞI TẠO WEB SERVER =====
  setupSPIFFS();
  setupWebServer();

  // ===== STARTUP ANIMATION =====
  // Hiển thị startup animation ở giữa màn hình
  display.clearDisplay();
  int iconX = (128 - FRAME_WIDTH) / 2;  // Căn giữa theo chiều ngang
  int iconY = (64 - FRAME_HEIGHT) / 2;  // Căn giữa theo chiều dọc

  // Chạy qua tất cả các frame của startup animation
  int numFrames = COUNT_OF(startupFrames);
  for (int i = 0; i < numFrames; i++) {
    display.clearDisplay();
    display.drawBitmap(iconX, iconY, startupFrames[i], FRAME_WIDTH, FRAME_HEIGHT, SSD1306_WHITE);
    display.display();
    delay(100);  // 100ms mỗi frame
  }

  delay(500);  // Dừng lại 0.5s sau animation cuối

  // ===== HIỂN THỊ PAGE 3 SAU STARTUP (với animation) =====
  // Hiển thị trạng thái data stream ngay sau startup với animation
  Serial.print("📺 Displaying Page 3 with status: ");
  Serial.println(blynkDataEnabled ? "ENABLED" : "DISABLED");
  const char* status = blynkDataEnabled ? "ENABLED" : "DISABLED";
  int numDataFrames = COUNT_OF(dataFrames);
  unsigned long page3StartTime = millis();
  int frame = 0;

  // Hiển thị page 3 trong 3 giây với animation
  while (millis() - page3StartTime < 3000) {
    display.clearDisplay();
    display.setTextSize(1);
    display.setTextColor(SSD1306_WHITE);

    // Tiêu đề "DATA STREAM" căn giữa
    const char* title = "DATA STREAM";
    int titleWidth = strlen(title) * 6;
    int titleX = (128 - titleWidth) / 2;
    display.setCursor(titleX, 0);
    display.println(title);

    // Gạch ngang
    display.drawLine(0, 10, 128, 10, SSD1306_WHITE);

    // Icon animation ở giữa
    display.drawBitmap(iconX, 16, dataFrames[frame % numDataFrames], FRAME_WIDTH, FRAME_HEIGHT, SSD1306_WHITE);

    // Status căn giữa
    int statusWidth = strlen(status) * 6;
    int statusX = (128 - statusWidth) / 2;
    display.setCursor(statusX, 52);
    display.println(status);

    display.display();
    delay(100);  // 100ms mỗi frame
    frame++;
  }

  // Reset timing để trang 1 hiển thị đầu tiên sau setup
  lastPageChange = millis();

  Serial.println("\nSetup complete!");
}

// ====================== LOOP ======================
void loop() {
  unsigned long now = millis();

  // Handle web server requests
  server.handleClient();

  // Đọc AHT20 (non-blocking với interval)
  aht20_read();

  // Đọc BMP280 pressure
  pressure = bmp280.readPressure() / 100.0F; // hPa

  // Đọc rain sensor mỗi 200ms
  if (now - lastRainRead >= RAIN_READ_INTERVAL) {
    rain_analog = analogRead(RAIN_AO);
    rain_digital = digitalRead(RAIN_DO);
    rain_level_percent = map(rain_analog, 4095, 0, 0, 100);
    detectRain(rain_analog, rain_digital, aht20_humidity, pressure);
    lastRainRead = now;
  }

  // Tính tốc độ gió
  calculateWindSpeed();

  updateAnimationFrames();

  // Kiểm tra nếu đang hiện trang 3 và đã hết thời gian
  if (showPage3 && (now - page3ShowTime >= PAGE3_DISPLAY_DURATION)) {
    showPage3 = false;  // Tắt trang 3, quay lại chu kỳ bình thường
  }

  // Auto-rotate trang 0-1 (chỉ khi không hiện trang 3)
  if (!showPage3 && (now - lastPageChange >= PAGE_INTERVAL)) {
    currentPage = (currentPage + 1) % 2;  // Chỉ xoay vòng 2 trang
    lastPageChange = now;
  }

  display.clearDisplay();
  display.setTextSize(1);
  display.setTextColor(SSD1306_WHITE);

  // Ưu tiên hiện trang 3 nếu được yêu cầu
  if (showPage3) {
    displayPage3();
  } else if (currentPage == 0) {
    displayPage1();
  } else {
    displayPage2();
  }

  display.display();

  Serial.print("Temp: ");
  Serial.print(aht20_temp, 1);
  Serial.print("°C | Humidity: ");
  Serial.print(aht20_humidity, 1);
  Serial.print("% | Rain: ");
  Serial.print(rain_level_percent);
  Serial.print("% | Status: ");
  Serial.println(rain_status);

  // ===== XỬ LÝ BLYNK =====
  // Gửi dữ liệu lên Blynk dashboard (mỗi 2 giây)
  handleBlynk(
    aht20_temp,           // V0: Nhiệt độ (°C)
    aht20_humidity,       // V1: Độ ẩm (%)
    rain_level_percent,   // V2: Mức mưa (%)
    rain_status,          // V3: Trạng thái mưa (String)
    pressure,             // V4: Áp suất (hPa)
    rain_digital          // V5: Digital value (0 hoặc 1)
  );

  // ===== GỬI DỮ LIỆU LÊN MONGODB =====
  // Gửi dữ liệu lên backend để lưu vào MongoDB (mỗi 5 giây)
  sendDataToBackend(
    aht20_temp,           // Nhiệt độ (°C)
    aht20_humidity,       // Độ ẩm (%)
    pressure,             // Áp suất (hPa)
    rain_level_percent,   // Mức mưa (%)
    wind_speed,           // Tốc độ gió (km/h)
    rain_status           // Trạng thái mưa (String)
  );

  // Không dùng delay() nữa để animation chạy mượt mà
}

// ====================== AHT20 ======================
bool aht20_begin() {
  Wire.beginTransmission(AHT20_ADDR);
  if (Wire.endTransmission() == 0) {
    delay(100);
    return true;
  }
  return false;
}

void aht20_read() {
  unsigned long now = millis();

  // Nếu chưa trigger hoặc đã qua thời gian đọc
  if (!sensorReadInProgress) {
    // Chỉ trigger nếu đã đủ interval từ lần đọc trước
    if (now - lastSensorRead >= SENSOR_READ_INTERVAL) {
      // Trigger measurement
      Wire.beginTransmission(AHT20_ADDR);
      Wire.write(0xAC);
      Wire.write(0x33);
      Wire.write(0x00);
      Wire.endTransmission();

      sensorReadInProgress = true;
      sensorTriggerTime = now;
    }
  } else {
    // Đợi 80ms sau khi trigger mới đọc data
    if (now - sensorTriggerTime >= 80) {
      Wire.requestFrom(AHT20_ADDR, 6);
      if (Wire.available() == 6) {
        uint8_t data[6];
        for (int i = 0; i < 6; i++) data[i] = Wire.read();

        if ((data[0] & 0x80) == 0) {
          uint32_t temp_raw = ((data[3] & 0x0F) << 16) | (data[4] << 8) | data[5];
          aht20_temp = temp_raw / 1048576.0 * 200.0 - 50.0;

          uint32_t humidity_raw = ((uint32_t)data[1] << 12) | ((uint32_t)data[2] << 4) | ((data[3] >> 4) & 0x0F);
          aht20_humidity = humidity_raw / 1048576.0 * 100.0;
        }
      }

      sensorReadInProgress = false;
      lastSensorRead = now;
    }
  }
}

// ====================== RAIN LOGIC ======================
void detectRain(int analog, int digital, float humidity, float pressure) {
  rain_status = "DRY";

  // Ưu tiên 1: Phát hiện mưa thực tế (sensor)
  // Ngưỡng: analog < 2400 = rain level > 41% (hợp lý với mưa thật)
  if (digital == HIGH || analog < 2400) {
    rain_status = "RAINING";
  }
  // Ưu tiên 2: Bề mặt ẩm ướt nhẹ
  // Ngưỡng: analog < 3200 = rain level 20-41% (ướt nhưng chưa mưa)
  else if (analog < 3200) {
    rain_status = "MOIST";
  }
  // Ưu tiên 3: Dự đoán sắp mưa (điều kiện khí hậu)
  else if (humidity > 85 || pressure < 1010) {
    rain_status = "LIKELY";
  }
  // Ưu tiên 4: Độ ẩm cao (không khí)
  else if (humidity > 70) {
    rain_status = "HUMID";
  }
  // Còn lại: Khô ráo (analog > 3200, rain level < 20%)
}

// ====================== ANIMATION STATE ======================
void updateAnimationFrames() {
  if (millis() - lastFrameUpdate > FRAME_DELAY) {
    tempAnimFrame = (tempAnimFrame + 1);
    humidityAnimFrame = (humidityAnimFrame + 1);
    dataAnimFrame = (dataAnimFrame + 1);
    lastFrameUpdate = millis();
  }
}

// Lấy frame nhiệt độ theo ngưỡng (lạnh/bình thường/nóng).
// Nếu USE_ANIM=0, hàm vẫn trả về con trỏ hợp lệ nhưng code hiển thị sẽ bỏ qua.
const uint8_t* getTempFrame() {
#if USE_ANIM
  if (aht20_temp < 10) {
    return coldFrames[tempAnimFrame % COUNT_OF(coldFrames)];
  } else if (aht20_temp <= 30) {
    return normalFrames[tempAnimFrame % COUNT_OF(normalFrames)];
  } else {
    return hotFrames[tempAnimFrame % COUNT_OF(hotFrames)];
  }
#else
  // Animation tắt: trả về dummy (không dùng)
  return coldFrames[0];
#endif
}

// ====================== HIỂN THỊ ======================
void displayPage1() {
  // Label nhiệt độ
  display.setTextSize(1);
  display.setCursor(0, 0);
  display.println("Temperature:");

  // Giá trị nhiệt độ
  display.setCursor(0, 10);
  display.setTextSize(2);
  display.printf("%.1f", aht20_temp);
  display.setTextSize(1);
  display.print("C");

#if USE_ANIM
  // Icon nhiệt độ (bên phải)
  display.drawBitmap(80, 0, getTempFrame(), FRAME_WIDTH, FRAME_HEIGHT, SSD1306_WHITE);
#else
  // Khi tắt animation: vẽ khung vuông đơn giản để giữ layout
  display.drawRect(80, 0, FRAME_WIDTH, FRAME_HEIGHT, SSD1306_WHITE);
  display.setCursor(86, 12);
  display.print("TEMP");
#endif

  // Label độ ẩm
  display.setCursor(0, 32);
  display.setTextSize(1);
  display.println("Humidity:");

  // Giá trị độ ẩm
  display.setCursor(0, 42);
  display.setTextSize(2);
  display.printf("%.0f", aht20_humidity);
  display.setTextSize(1);
  display.print("%");

#if USE_ANIM
  // Icon độ ẩm (bên phải)
  display.drawBitmap(
    80, 30,
    humidityFrames[humidityAnimFrame % COUNT_OF(humidityFrames)],
    FRAME_WIDTH, FRAME_HEIGHT,
    SSD1306_WHITE
  );
#else
  // Khi tắt animation: vẽ khung vuông đơn giản
  display.drawRect(80, 30, FRAME_WIDTH, FRAME_HEIGHT, SSD1306_WHITE);
  display.setCursor(86, 44);
  display.print("HUM");
#endif
}

void displayPage2() {
  // Tiêu đề
  display.setTextSize(1);
  display.setCursor(0, 0);
  display.println("WEATHER DATA");

  // Gạch ngang
  display.drawLine(0, 10, 128, 10, SSD1306_WHITE);

  // Wind Speed (tốc độ gió)
  display.setCursor(0, 14);
  display.print("Wind: ");
  display.print(wind_speed, 1);
  display.println(" km/h");

  // Rain Status
  display.setCursor(0, 24);
  display.print("Rain: ");
  display.println(rain_status);

  // Rain Level
  display.setCursor(0, 32);
  display.print("Rain Lv: ");
  display.print(rain_level_percent);
  display.println("%");

  // Pressure
  display.setCursor(0, 42);
  display.print("Pressure: ");
  display.print(pressure, 0);
  display.println(" hPa");

  // Weather status text
  display.setCursor(0, 52);
  if (rain_status == "RAINING") {
    display.println("IT'S RAINING!");
  } else if (rain_status == "MOIST") {
    display.println("Ground is wet");
  } else if (wind_speed > 20) {
    display.println("Windy!");
  } else {
    display.println("All clear");
  }
}

void displayPage3() {
  // Tiêu đề "DATA STREAM" căn giữa
  display.setTextSize(1);
  const char* title = "DATA STREAM";
  int titleWidth = strlen(title) * 6;  // Font mặc định 6px/char
  int titleX = (128 - titleWidth) / 2;
  display.setCursor(titleX, 0);
  display.println(title);

  // Gạch ngang
  display.drawLine(0, 10, 128, 10, SSD1306_WHITE);

#if USE_ANIM
  // Icon animation căn giữa
  int iconX = (128 - FRAME_WIDTH) / 2;  // (128-32)/2 = 48
  int iconY = 16;  // Y position để có khoảng trống phía trên và dưới
  display.drawBitmap(
    iconX, iconY,
    dataFrames[dataAnimFrame % COUNT_OF(dataFrames)],
    FRAME_WIDTH, FRAME_HEIGHT,
    SSD1306_WHITE
  );
#else
  // Khi tắt animation: vẽ khung vuông
  int iconX = (128 - FRAME_WIDTH) / 2;
  int iconY = 16;
  display.drawRect(iconX, iconY, FRAME_WIDTH, FRAME_HEIGHT, SSD1306_WHITE);
  display.setCursor(iconX + 4, iconY + 12);
  display.print("DATA");
#endif

  // Status "ENABLED" hoặc "DISABLED" căn giữa dưới icon
  display.setTextSize(1);
  const char* status = blynkDataEnabled ? "ENABLED" : "DISABLED";
  int statusWidth = strlen(status) * 6;
  int statusX = (128 - statusWidth) / 2;
  display.setCursor(statusX, 52);
  display.println(status);
}

// ====================== WEB SERVER FUNCTIONS ======================

void setupSPIFFS() {
  Serial.println("📁 Mounting SPIFFS...");
  if (!SPIFFS.begin(true)) {
    Serial.println("✗ SPIFFS Mount Failed");
    return;
  }
  Serial.println("✓ SPIFFS Mounted Successfully");

  // List files
  Serial.println("📂 Files in SPIFFS:");
  File root = SPIFFS.open("/");
  if (!root) {
    Serial.println("  ✗ Failed to open root directory");
    return;
  }
  if (!root.isDirectory()) {
    Serial.println("  ✗ Root is not a directory");
    return;
  }

  File file = root.openNextFile();
  int fileCount = 0;
  while (file) {
    if (!file.isDirectory()) {
      Serial.print("  FILE: ");
      Serial.print(file.name());
      Serial.print("  SIZE: ");
      Serial.println(file.size());
      fileCount++;
    }
    file.close();
    file = root.openNextFile();
  }

  if (fileCount == 0) {
    Serial.println("  ⚠️ No files found! SPIFFS may be empty.");
    Serial.println("  💡 Try: Tools → Partition Scheme → 'Default 4MB with spiffs'");
  } else {
    Serial.printf("  ✓ Total files: %d\n", fileCount);
  }
  root.close();
}

void setupWebServer() {
  // Serve static files from SPIFFS
  server.on("/", HTTP_GET, []() {
    Serial.println("📥 Request: /");
    File file = SPIFFS.open("/index.html", "r");
    if (!file) {
      Serial.println("  ✗ /index.html not found!");
      server.send(404, "text/plain", "index.html not found in SPIFFS");
      return;
    }
    Serial.println("  ✓ Serving /index.html");
    server.streamFile(file, "text/html");
    file.close();
  });

  server.on("/style.css", HTTP_GET, []() {
    File file = SPIFFS.open("/style.css", "r");
    if (!file) {
      server.send(404, "text/plain", "File not found");
      return;
    }
    server.streamFile(file, "text/css");
    file.close();
  });

  server.on("/app.js", HTTP_GET, []() {
    File file = SPIFFS.open("/app.js", "r");
    if (!file) {
      server.send(404, "text/plain", "File not found");
      return;
    }
    server.streamFile(file, "application/javascript");
    file.close();
  });

  // API endpoint for weather data
  server.on("/api/weather", HTTP_GET, []() {
    String json = getWeatherJSON();
    server.send(200, "application/json", json);
  });

  // API endpoint for firmware version
  server.on("/api/version", HTTP_GET, []() {
    String json = "{\"version\":\"" + String(FIRMWARE_VERSION) + "\"}";
    server.send(200, "application/json", json);
  });

  // OTA Update endpoint
  server.on("/update", HTTP_POST, []() {
    // Sau khi upload xong
    if (Update.hasError()) {
      server.send(500, "text/plain", "Update failed: " + String(Update.errorString()));
    } else {
      server.send(200, "text/plain", "Update successful! Rebooting...");
      delay(1000);
      ESP.restart();
    }
  }, []() {
    // Xử lý upload từng chunk
    HTTPUpload& upload = server.upload();

    if (upload.status == UPLOAD_FILE_START) {
      Serial.printf("OTA Update: %s\n", upload.filename.c_str());
      if (!Update.begin(UPDATE_SIZE_UNKNOWN)) {
        Update.printError(Serial);
      }
    } else if (upload.status == UPLOAD_FILE_WRITE) {
      if (Update.write(upload.buf, upload.currentSize) != upload.currentSize) {
        Update.printError(Serial);
      }
    } else if (upload.status == UPLOAD_FILE_END) {
      if (Update.end(true)) {
        Serial.printf("OTA Update Success: %u bytes\n", upload.totalSize);
      } else {
        Update.printError(Serial);
      }
    }
  });

  // 404 handler
  server.onNotFound([]() {
    server.send(404, "text/plain", "Not found");
  });

  server.begin();
  Serial.println("✓ Web Server started on port 80");
  Serial.print("✓ Access web interface at: http://");
  Serial.println(WiFi.localIP());
}

String getWeatherJSON() {
  StaticJsonDocument<256> doc;

  doc["temperature"] = round(aht20_temp * 10) / 10.0;
  doc["humidity"] = round(aht20_humidity);
  doc["rain_level"] = rain_level_percent;
  doc["rain_status"] = rain_status;
  doc["pressure"] = round(pressure);
  doc["wind_speed"] = round(wind_speed * 10) / 10.0;
  doc["digital"] = rain_digital;

  String output;
  serializeJson(doc, output);
  return output;
}
